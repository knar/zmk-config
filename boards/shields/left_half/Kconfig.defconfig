## boards/shields/left_half/Kconfig.defconfig
```kconfig
if SHIELD_LEFT_HALF

config ZMK_KEYBOARD_NAME
    default "left_half"

endif # SHIELD_LEFT_HALF
```

## boards/shields/nydus/Kconfig.defconfig
```kconfig
config ZMK_SPLIT
    default y

if SHIELD_NYDUS_DONGLE

config ZMK_KEYBOARD_NAME
    default "Nydus"

config ZMK_SPLIT_ROLE_CENTRAL
    default y

config ZMK_SPLIT_BLE_CENTRAL_PERIPHERALS
    default 2

endif
```

## boards/shields/nydus/Kconfig.shield
```kconfig
config SHIELD_NYDUS_DONGLE
    def_bool $(shields_list_contains,nydus_dongle)

config SHIELD_NYDUS_LEFT
    def_bool $(shields_list_contains,nydus_left)

config SHIELD_NYDUS_RIGHT
    def_bool $(shields_list_contains,nydus_right)
```
